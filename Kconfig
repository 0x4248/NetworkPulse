## Kconfig
```kconfig
# Network Pulse
# A simple arp table like tool to see if clients are connected and alive on the network.
# GitHub: https://www.github.com/lewisevans2007/NetworkPulse
# Licence: GNU General Public License v3.0
# By: Lewis Evans
#
# Kconfig file for Network Pulse

menu "Client options"

config DEFAULT_PORT
    int "Default port"
    default 2002
    help
      Default port for the server to listen on.

config DEFAULT_SERVER_IP
    string "Default server IP"
    default "192.168.1.1"
    help
      Default server IP for the server to listen on.

endmenu

menu "Server options"

config PULSE_TABLE
    bool "Enable pulse table"
    default y
    help
      A pulse table allows NetworkPulse to create a file that stores the currently connected clients.

config PULSE_TABLE_FILE_NAME
    string "Pulse table file name"
    default "pulse_table"
    depends on PULSE_TABLE
    help
      Pulse table file name. Set this to a path to store the file in a different location. e.g ~/pulse_table or leave as a file name to store in the current directory.

config ENABLE_LOGGING
    bool "Enable console logging"
    default y
    help
      Enable logging to terminal.

config SHOW_PULSES
    bool "Show pulse logs"
    default y
    depends on ENABLE_LOGGING
    help
      Show pulse logs to terminal.

config SAVE_PULSE_LOGS
    bool "Save pulse logs"
    default y
    depends on ENABLE_LOGGING
    help
      Save pulse logs to file.

config PULSE_LOG_FILE_NAME
    string "Pulse log file name"
    default "pulse.log"
    depends on SAVE_PULSE_LOGS
    help
      Pulse log file name.

endmenu
```
